## arch/riscv/Kconfig
```kconfig
menu "RISCV architecture"
	depends on RISCV

config SYS_ARCH
	default "riscv"

config NVDLA_IOFPGA
    bool "Support NVDLA IOFPGA"

choice
	prompt "Target select"
	optional

config TARGET_AX25_AE350
	bool "Support ax25-ae350"
	
config TARGET_HIFIVE_U540
    bool "Support HiFive-U540"

config TARGET_MICROCHIP_LC_MPFS
    bool "Support lc-mpfs"
    
endchoice

source "board/AndesTech/ax25-ae350/Kconfig"
source "board/SiFive/HiFive-U540/Kconfig"
source "board/microchip/lc-mpfs/Kconfig"

choice
	prompt "CPU selection"
	default CPU_RISCV_64

config CPU_RISCV_32
	bool "RISCV 32 bit"
	select 32BIT
	help
	  Choose this option to build an U-Boot for RISCV32 architecture.

config CPU_RISCV_64
	bool "RISCV 64 bit"
	select 64BIT
	help
	  Choose this option to build an U-Boot for RISCV64 architecture.

endchoice

config 32BIT
	bool

config 64BIT
	bool

endmenu
```

## board/microchip/lc-mpfs/Kconfig
```kconfig
if TARGET_MICROCHIP_LC_MPFS

config SYS_CPU
	default "HiFive-no-otp"

config SYS_BOARD
	default "lc-mpfs"

config SYS_VENDOR
	default "microchip"

config SYS_SOC
	default "lc-mpfs"

config SYS_CONFIG_NAME
	default "mchp-lc-mpfs"

config ENV_SIZE
	default 0x2000 if ENV_IS_IN_SPI_FLASH

config ENV_OFFSET
	default 0x140000 if ENV_IS_IN_SPI_FLASH

endif
```

## configs/HiFive-U540_defconfig
```kconfig
CONFIG_RISCV=y
CONFIG_SYS_TEXT_BASE=0x08000000
CONFIG_TARGET_HIFIVE_U540=y
CONFIG_NR_DRAM_BANKS=1
CONFIG_FIT=y
CONFIG_BOOTDELAY=3
CONFIG_MISC_INIT_R=y
CONFIG_SYS_PROMPT="RISC-V # "
CONFIG_CMD_MMC=y
CONFIG_CMD_MMC_SPI=y
CONFIG_CMD_DHCP=y
CONFIG_OF_CONTROL=y
CONFIG_DEFAULT_DEVICE_TREE="hifive_u540"
CONFIG_DM=y
CONFIG_MISC=y
CONFIG_HIFIVE_OTP=y
CONFIG_MMC=y
CONFIG_PHYLIB=y
CONFIG_PHY_MSCC=y
CONFIG_HIFIVE_SERIAL=y
```
